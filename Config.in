## Config.in
```kconfig
source "$BR2_EXTERNAL_MESHTASTIC_PATH/package/meta-cli-tools/Config.in"

source "$BR2_EXTERNAL_MESHTASTIC_PATH/package/compat-python-pip/Config.in.host"
source "$BR2_EXTERNAL_MESHTASTIC_PATH/package/compat-python-poetry-core/Config.in.host"

source "$BR2_EXTERNAL_MESHTASTIC_PATH/package/python-tabulate/Config.in.host"
source "$BR2_EXTERNAL_MESHTASTIC_PATH/package/python-platformio/Config.in.host"
source "$BR2_EXTERNAL_MESHTASTIC_PATH/package/liborcania/Config.in"
source "$BR2_EXTERNAL_MESHTASTIC_PATH/package/libyder/Config.in"
source "$BR2_EXTERNAL_MESHTASTIC_PATH/package/libulfius/Config.in"
source "$BR2_EXTERNAL_MESHTASTIC_PATH/package/meshtasticd/Config.in"
source "$BR2_EXTERNAL_MESHTASTIC_PATH/package/meshtasticd-web/Config.in"


source "$BR2_EXTERNAL_MESHTASTIC_PATH/package/lichee-cvi-pinmux/Config.in"
```
